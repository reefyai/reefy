## Config.in
```kconfig
source "$BR2_EXTERNAL_SBNB_PATH/package/sevctl/Config.in"
source "$BR2_EXTERNAL_SBNB_PATH/package/snpguest/Config.in"
source "$BR2_EXTERNAL_SBNB_PATH/package/fatresize/Config.in"
source "$BR2_EXTERNAL_SBNB_PATH/package/python-ansible-core/Config.in"
source "$BR2_EXTERNAL_SBNB_PATH/package/python-resolvelib/Config.in"
source "$BR2_EXTERNAL_SBNB_PATH/package/sbnb-ansible-collections/Config.in"
source "$BR2_EXTERNAL_SBNB_PATH/package/mgmt/Config.in"
source "$BR2_EXTERNAL_SBNB_PATH/package/nvidia-open-gpu/Config.in"
source "$BR2_EXTERNAL_SBNB_PATH/package/nvidia-gsp-firmware/Config.in"
source "$BR2_EXTERNAL_SBNB_PATH/package/nvidia-userspace/Config.in"
source "$BR2_EXTERNAL_SBNB_PATH/package/nvidia-container-toolkit/Config.in"
source "$BR2_EXTERNAL_SBNB_PATH/package/borgbackup/Config.in"
source "$BR2_EXTERNAL_SBNB_PATH/package/r8125/Config.in"
source "$BR2_EXTERNAL_SBNB_PATH/package/r8126/Config.in"
source "$BR2_EXTERNAL_SBNB_PATH/package/r8127/Config.in"
source "$BR2_EXTERNAL_SBNB_PATH/package/r8168/Config.in"
source "$BR2_EXTERNAL_SBNB_PATH/package/tailscale-reefy/Config.in"
```

## package/borgbackup/Config.in
```kconfig
config BR2_PACKAGE_BORGBACKUP
	bool "borgbackup"
	help
	  BorgBackup (Borg) — deduplicating archiver with compression
	  and encryption. Pre-built standalone binary for x86_64.

	  https://www.borgbackup.org/
```

## package/mgmt/Config.in
```kconfig
config BR2_PACKAGE_MGMT
	bool "mgmt"
	depends on BR2_PACKAGE_HOST_GO_TARGET_ARCH_SUPPORTS
	select BR2_PACKAGE_HOST_GO
	help
	  Next generation distributed, event-driven, parallel config
	  management. Runs as a daemon with real-time drift correction
	  via inotify. Includes docker container resource support.

	  https://github.com/purpleidea/mgmt

comment "mgmt needs a toolchain w/ Go support"
	depends on !BR2_PACKAGE_HOST_GO_TARGET_ARCH_SUPPORTS
```

## package/nvidia-container-toolkit/Config.in
```kconfig
config BR2_PACKAGE_NVIDIA_CONTAINER_TOOLKIT
	bool "nvidia-container-toolkit"
	depends on BR2_x86_64
	depends on BR2_PACKAGE_HOST_GO_TARGET_CGO_LINKING_SUPPORTS
	select BR2_PACKAGE_NVIDIA_USERSPACE
	help
	  NVIDIA Container Toolkit provides CDI (Container Device Interface)
	  support for GPU access in containers. Includes nvidia-ctk for
	  generating CDI specs and nvidia-cdi-hook for container lifecycle
	  hooks. Use with: docker run --device=nvidia.com/gpu=all

	  https://github.com/NVIDIA/nvidia-container-toolkit
```

## package/nvidia-gsp-firmware/Config.in
```kconfig
config BR2_PACKAGE_NVIDIA_GSP_FIRMWARE
	bool "nvidia-gsp-firmware"
	depends on BR2_x86_64
	help
	  NVIDIA GSP (GPU System Processor) firmware for Turing and
	  newer GPUs. Required by the open-source NVIDIA kernel modules.

	  Firmware files are extracted from the official NVIDIA driver
	  installer and installed to /lib/firmware/nvidia/<version>/.

	  https://www.nvidia.com/en-us/drivers/unix/
```

## package/nvidia-open-gpu/Config.in
```kconfig
comment "nvidia-open-gpu needs a Linux kernel to be built"
	depends on !BR2_LINUX_KERNEL

config BR2_PACKAGE_NVIDIA_OPEN_GPU
	bool "nvidia-open-gpu"
	depends on BR2_LINUX_KERNEL
	depends on BR2_x86_64 || BR2_aarch64
	depends on BR2_TOOLCHAIN_USES_GLIBC
	select BR2_LINUX_NEEDS_MODULES
	help
	  NVIDIA open-source GPU kernel modules (nvidia.ko,
	  nvidia-modeset.ko, nvidia-drm.ko, nvidia-uvm.ko).

	  Supports Turing (RTX 20xx) and newer GPU architectures.
	  Requires matching GSP firmware (nvidia-gsp-firmware).

	  https://github.com/NVIDIA/open-gpu-kernel-modules

comment "nvidia-open-gpu needs a glibc toolchain"
	depends on BR2_x86_64 || BR2_aarch64
	depends on !BR2_TOOLCHAIN_USES_GLIBC
```

## package/nvidia-userspace/Config.in
```kconfig
config BR2_PACKAGE_NVIDIA_USERSPACE
	bool "nvidia-userspace"
	depends on BR2_x86_64
	help
	  NVIDIA userspace driver libraries and tools extracted from the
	  official driver installer. Provides nvidia-smi, libnvidia-ml.so
	  and libcuda.so for GPU monitoring and CUDA container support.

	  Install path: /usr/lib/nvidia/ (libraries), /usr/bin/ (nvidia-smi)

	  https://www.nvidia.com/en-us/drivers/unix/
```

## package/r8125/Config.in
```kconfig
comment "r8125 needs a Linux kernel to be built"
	depends on !BR2_LINUX_KERNEL

config BR2_PACKAGE_R8125
	bool "r8125"
	depends on BR2_LINUX_KERNEL
	depends on BR2_x86_64
	select BR2_LINUX_NEEDS_MODULES
	help
	  Realtek r8125 2.5 Gigabit Ethernet driver for RTL8125
	  series controllers. Replaces the in-kernel r8169 driver.

	  https://github.com/openwrt/rtl8125
```

## package/r8126/Config.in
```kconfig
comment "r8126 needs a Linux kernel to be built"
	depends on !BR2_LINUX_KERNEL

config BR2_PACKAGE_R8126
	bool "r8126"
	depends on BR2_LINUX_KERNEL
	depends on BR2_x86_64
	select BR2_LINUX_NEEDS_MODULES
	help
	  Realtek r8126 5 Gigabit Ethernet driver for RTL8126
	  series controllers. Replaces the in-kernel r8169 driver.

	  https://github.com/openwrt/rtl8126
```

## package/r8127/Config.in
```kconfig
comment "r8127 needs a Linux kernel to be built"
	depends on !BR2_LINUX_KERNEL

config BR2_PACKAGE_R8127
	bool "r8127"
	depends on BR2_LINUX_KERNEL
	depends on BR2_x86_64
	select BR2_LINUX_NEEDS_MODULES
	help
	  Realtek r8127 Ethernet driver for RTL8127 series controllers.
	  Replaces the in-kernel r8169 driver.

	  https://github.com/openwrt/rtl8127
```

## package/r8168/Config.in
```kconfig
comment "r8168 needs a Linux kernel to be built"
	depends on !BR2_LINUX_KERNEL

config BR2_PACKAGE_R8168
	bool "r8168"
	depends on BR2_LINUX_KERNEL
	depends on BR2_x86_64
	select BR2_LINUX_NEEDS_MODULES
	help
	  Realtek r8168 Gigabit Ethernet driver for RTL8111/RTL8168
	  series controllers. Replaces the in-kernel r8169 driver
	  which has known TX watchdog timeout issues on certain
	  hardware revisions.

	  https://github.com/openwrt/rtl8168
```

## package/reefy-ansible-collections/Config.in
```kconfig
config BR2_PACKAGE_REEFY_ANSIBLE_COLLECTIONS
	bool "reefy-ansible-collections"
	depends on BR2_PACKAGE_PYTHON_ANSIBLE_CORE
	help
	  Pre-install required Ansible collections for Reefy:
	  - community.general
	  - community.crypto
	  - community.docker
	  - ansible.posix
	  - geerlingguy.docker (role)

comment "reefy-ansible-collections needs python-ansible-core"
	depends on !BR2_PACKAGE_PYTHON_ANSIBLE_CORE
```

## package/sbnb-ansible-collections/Config.in
```kconfig
config BR2_PACKAGE_SBNB_ANSIBLE_COLLECTIONS
	bool "sbnb-ansible-collections"
	depends on BR2_PACKAGE_PYTHON_ANSIBLE_CORE
	help
	  Pre-install required Ansible collections for SBNB:
	  - community.general
	  - community.crypto
	  - community.docker
	  - ansible.posix
	  - geerlingguy.docker (role)

comment "sbnb-ansible-collections needs python-ansible-core"
	depends on !BR2_PACKAGE_PYTHON_ANSIBLE_CORE
```

## package/tailscale-reefy/Config.in
```kconfig
config BR2_PACKAGE_TAILSCALE_REEFY
	bool "tailscale-reefy"
	depends on BR2_PACKAGE_HOST_GO_TARGET_ARCH_SUPPORTS
	depends on !BR2_PACKAGE_TAILSCALE
	select BR2_PACKAGE_HOST_GO
	help
	  Local fork of upstream's tailscale package, carrying two
	  changes that haven't been upstreamed:

	  1. Omits the broken TAILSCALE_INSTALL_SYMLINK hook. Upstream
	     creates /usr/sbin/tailscaled as a symlink to ../bin/tailscaled.
	     With BR2_ROOTFS_MERGED_USR=y (required by systemd),
	     /usr/sbin -> /usr/bin, so the ln -f follows the symlink and
	     overwrites the real binary at /usr/bin/tailscaled with a
	     circular symlink, destroying tailscaled.

	  2. Pins a newer tailscale version than upstream buildroot.

	  Delete this package and switch back to BR2_PACKAGE_TAILSCALE
	  once upstream catches up.

	  https://github.com/tailscale/tailscale
```
